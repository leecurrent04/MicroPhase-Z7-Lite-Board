/ {
	amba_pl: amba_pl {
		ranges;
		compatible = "simple-bus";
		#address-cells = <1>;
		#size-cells = <1>;
		firmware-name = "system_wrapper.bit.bin";
		clocking0: clocking0 {
			compatible = "xlnx,fclk";
			assigned-clocks = <&clkc 15>;
			assigned-clock-rates = <100000000>;
			#clock-cells = <0>;
			clock-output-names = "fabric_clk";
			clocks = <&clkc 15>;
		};
		Blink_0: Blink@43c00000 {
			xlnx,rable = <0>;
			xlnx,s00-axi-data-width = <32>;
			compatible = "xlnx,Blink-1.0";
			status = "okay";
			clock-names = "s00_axi_aclk";
			xlnx,s00-axi-addr-width = <4>;
			xlnx,ip-name = "Blink";
			xlnx,edk-iptype = "PERIPHERAL";
			reg = <0x43c00000 0x10000>;
			clocks = <&clkc 15>;
			xlnx,name = "Blink_0";
		};
	};
};
